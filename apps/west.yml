## apps/west.yml
```yaml
manifest:
  version: 0.7

  self:
    path: apps

  defaults:
    remote: zephyrproject

  remotes:
    - name: zephyrproject
      url-base: https://github.com/zephyrproject-rtos
    - name: golioth
      url-base: https://github.com/golioth

  projects:
    - name: zephyr
      revision: v3.6.0
      remote: zephyrproject
      repo-path: zephyr
      import:
        path-prefix: deps
        name-whitelist:
          - hal_espressif
      path: zephyr
    - name: golioth
      revision: v0.11.1
      remote: golioth
      repo-path: golioth-firmware-sdk
      path: deps/modules/golioth-firmware-sdk
       
```
